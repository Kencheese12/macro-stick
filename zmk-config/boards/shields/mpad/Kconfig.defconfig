## zmk-config/boards/shields/mpad/Kconfig.defconfig
```kconfig
# File: boards/shields/mpad/Kconfig.defconfig
if SHIELD_MPAD

config ZMK_KEYBOARD_NAME
    default "MPad Strip"

endif
```

## zmk-config/boards/shields/mpad/Kconfig.shield
```kconfig
# File: boards/shields/mpad/Kconfig.shield
config SHIELD_MPAD
    def_bool $(shields_list_contains,mpad)
```
